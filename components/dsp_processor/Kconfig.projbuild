## components/dsp_processor/Kconfig.projbuild
```kconfig
# Config file for ESP32 DSP Processor

menu "ESP32 audio buffer and I2S config"
    config USE_DSP_PROCESSOR
        bool "enable signal processing on audio data"
        default false
        help
            enable audio filtering before queueing it to player component

    choice SNAPCLIENT_DSP_FLOW
        prompt "DSP flow"
        default SNAPCLIENT_DSP_FLOW_STEREO
        depends on USE_DSP_PROCESSOR
        help
            Select the DSP flow to use.

        config SNAPCLIENT_DSP_FLOW_STEREO
            bool "Stereo flow"

        config SNAPCLIENT_DSP_FLOW_BASSBOOST
            bool "Bassboost flow"

        config SNAPCLIENT_DSP_FLOW_BIAMP
            bool "Bi-Amp flow"
    endchoice

    config USE_BIQUAD_ASM
        bool "Use uptimized asm version of Biquad_f32"
        default true
        depends on USE_DSP_PROCESSOR
        help
            Asm version 2 x speed on ESP32 - not working on ESP32-S2

    config SNAPCLIENT_USE_SOFT_VOL
        bool "Use software volume"
        default false
        depends on USE_DSP_PROCESSOR
        help
            Use software volume mixer instead of hardware mixer.

endmenu
```

## components/eth_interface/Kconfig.projbuild
```kconfig
menu "Snapclient Ethernet Configuration"
    config SNAPCLIENT_ENABLE_ETHERNET
        bool "enable Ethernet"
        default n
        help
            Enable Ethernet interface

    config SNAPCLIENT_USE_SPI_ETHERNET
        bool
        depends on SNAPCLIENT_ENABLE_ETHERNET

    choice SNAPCLIENT_ETHERNET_TYPE
        prompt "Ethernet Type"
        default SNAPCLIENT_USE_INTERNAL_ETHERNET if IDF_TARGET_ESP32
        default SNAPCLIENT_USE_W5500
        depends on SNAPCLIENT_ENABLE_ETHERNET
        help
            Select which kind of Ethernet will be used in the example.

        config SNAPCLIENT_USE_INTERNAL_ETHERNET
            depends on IDF_TARGET_ESP32
            select ETH_USE_ESP32_EMAC
            bool "Internal EMAC"
            help
                Select internal Ethernet MAC controller.

        config SNAPCLIENT_USE_DM9051
            bool "DM9051 Module"
            select SNAPCLIENT_USE_SPI_ETHERNET
            select ETH_USE_SPI_ETHERNET
            select ETH_SPI_ETHERNET_DM9051
            help
                Select external SPI-Ethernet module (DM9051).

        config SNAPCLIENT_USE_W5500
            bool "W5500 Module"
            select SNAPCLIENT_USE_SPI_ETHERNET
            select ETH_USE_SPI_ETHERNET
            select ETH_SPI_ETHERNET_W5500
            help
                Select external SPI-Ethernet module (W5500).
    endchoice # SNAPCLIENT_ETHERNET_TYPE

    if SNAPCLIENT_USE_INTERNAL_ETHERNET
        choice SNAPCLIENT_ETH_PHY_MODEL
            prompt "Ethernet PHY Device"
            default SNAPCLIENT_ETH_PHY_IP101
            depends on SNAPCLIENT_ENABLE_ETHERNET
            help
                Select the Ethernet PHY device to use in the example.

            config SNAPCLIENT_ETH_PHY_IP101
                bool "IP101"
                help
                    IP101 is a single port 10/100 MII/RMII/TP/Fiber Fast Ethernet Transceiver.
                    Goto http://www.icplus.com.tw/pp-IP101G.html for more information about it.

            config SNAPCLIENT_ETH_PHY_RTL8201
                bool "RTL8201/SR8201"
                help
                    RTL8201F/SR8201F is a single port 10/100Mb Ethernet Transceiver with auto MDIX.
                    Goto http://www.corechip-sz.com/productsview.asp?id=22 for more information about it.

            config SNAPCLIENT_ETH_PHY_LAN8720
                bool "LAN8720"
                help
                    LAN8720A is a small footprint RMII 10/100 Ethernet Transceiver with HP Auto-MDIX Support.
                    Goto https://www.microchip.com/LAN8720A for more information about it.

            config SNAPCLIENT_ETH_PHY_DP83848
                bool "DP83848"
                help
                    DP83848 is a single port 10/100Mb/s Ethernet Physical Layer Transceiver.
                    Goto http://www.ti.com/product/DP83848J for more information about it.

            config SNAPCLIENT_ETH_PHY_KSZ8041
                bool "KSZ8041"
                help
                    The KSZ8041 is a single supply 10Base-T/100Base-TX Physical Layer Transceiver.
                    Goto https://www.microchip.com/wwwproducts/en/KSZ8041 for more information about it.
        endchoice # SNAPCLIENT_ETH_PHY_MODEL

        config SNAPCLIENT_ETH_MDC_GPIO
            int "SMI MDC GPIO number"
            default 23
            depends on SNAPCLIENT_ENABLE_ETHERNET
            help
                Set the GPIO number used by SMI MDC.

        config SNAPCLIENT_ETH_MDIO_GPIO
            int "SMI MDIO GPIO number"
            default 18
            depends on SNAPCLIENT_ENABLE_ETHERNET
            help
                Set the GPIO number used by SMI MDIO.
    endif # SNAPCLIENT_USE_INTERNAL_ETHERNET

    if SNAPCLIENT_USE_SPI_ETHERNET
        config SNAPCLIENT_ETH_SPI_HOST
            int "SPI Host Number"
            range 0 2
            default 1
            depends on SNAPCLIENT_ENABLE_ETHERNET
            help
                Set the SPI host used to communicate with the SPI Ethernet Controller.

        config SNAPCLIENT_ETH_SPI_SCLK_GPIO
            int "SPI SCLK GPIO number"
            range 0 33
            default 20
            depends on SNAPCLIENT_ENABLE_ETHERNET
            help
                Set the GPIO number used by SPI SCLK.

        config SNAPCLIENT_ETH_SPI_MOSI_GPIO
            int "SPI MOSI GPIO number"
            range 0 33
            default 19
            depends on SNAPCLIENT_ENABLE_ETHERNET
            help
                Set the GPIO number used by SPI MOSI.

        config SNAPCLIENT_ETH_SPI_MISO_GPIO
            int "SPI MISO GPIO number"
            range 0 33
            default 18
            depends on SNAPCLIENT_ENABLE_ETHERNET
            help
                Set the GPIO number used by SPI MISO.

        config SNAPCLIENT_ETH_SPI_CS_GPIO
            int "SPI CS GPIO number"
            range 0 33
            default 21
            depends on SNAPCLIENT_ENABLE_ETHERNET
            help
                Set the GPIO number used by SPI CS.

        config SNAPCLIENT_ETH_SPI_CLOCK_MHZ
            int "SPI clock speed (MHz)"
            range 5 80
            default 36
            depends on SNAPCLIENT_ENABLE_ETHERNET
            help
                Set the clock speed (MHz) of SPI interface.

        config SNAPCLIENT_ETH_SPI_INT_GPIO
            int "Interrupt GPIO number"
            default 4
            depends on SNAPCLIENT_ENABLE_ETHERNET
            help
                Set the GPIO number used by the SPI Ethernet module interrupt line.
    endif # SNAPCLIENT_USE_SPI_ETHERNET

    config SNAPCLIENT_ETH_PHY_RST_GPIO
        int "PHY Reset GPIO number"
        default 17
        depends on SNAPCLIENT_ENABLE_ETHERNET
        help
            Set the GPIO number used to reset PHY chip.
            Set to -1 to disable PHY chip hardware reset.

    config SNAPCLIENT_ETH_PHY_ADDR
        int "PHY Address"
        range 0 31
        default 0
        depends on SNAPCLIENT_ENABLE_ETHERNET
        help
            Set PHY address according your board schematic.
endmenu
```

## components/ui_http_server/Kconfig.projbuild
```kconfig
menu "Application Configuration"

	menu "HTTP Server Setting"

		config WEB_PORT
			int "HTTP Server Port"
			default 8000
			help
				HTTP server port to use.

	endmenu

	menu "GPIO Setting"

		config GPIO_RANGE_MAX
			int
			default 33 if IDF_TARGET_ESP32
			default 46 if IDF_TARGET_ESP32S2
			default 48 if IDF_TARGET_ESP32S3
			default 19 if IDF_TARGET_ESP32C3

		config BLINK_GPIO
			int "Blink GPIO number"
			range 0 GPIO_RANGE_MAX
			default  5
			help
				GPIO number (IOxx) to blink on and off or the RMT signal for the addressable LED.
				Some GPIOs are used for other purposes (flash connections, etc.) and cannot be used to blink.

	endmenu

endmenu
```

## components/wifi_interface/Kconfig.projbuild
```kconfig
menu "Wifi Configuration"
    config ENABLE_WIFI_PROVISIONING
        bool "enable WiFi provisioning"
        default n
        help
            Enable WiFi provisioning so espressif APP can be used to provison WiFi credentials

    config WIFI_PROVISIONING_SSID
        string "WiFi provisioning SSID"
        default "prov_snapclient"
        depends on ENABLE_WIFI_PROVISIONING
        help
            SSID (network name) to use for provisioning access point. Shouldn't be longer than 20 characters.

    config WIFI_PROVISIONING_PASSWORD
        string "WiFi provisioning password"
        default "12345678"
        depends on ENABLE_WIFI_PROVISIONING
        help
            WiFi password (WPA or WPA2) to use for provisioning access point

    config WIFI_SSID
        string "WiFi SSID"
        default "myssid"
        depends on !ENABLE_WIFI_PROVISIONING
        help
            SSID (network name) for the example to connect to.

    config WIFI_PASSWORD
        string "WiFi Password"
        default "mypassword"
        depends on !ENABLE_WIFI_PROVISIONING
        help
            WiFi password (WPA or WPA2) for the example to use.

    config WIFI_MAXIMUM_RETRY
        int "Maximum retry"
        default 5
        help
            Set the Maximum retry to avoid station reconnecting to the AP unlimited when the AP is really inexistent.
            Set to 0 if unlimited reconnections are preferred.
endmenu
```

## main/Kconfig.projbuild
```kconfig
menu "Snapcast Configuration"

    config SNAPSERVER_USE_MDNS
        bool "Use mDNS"
        default true
        help
            Use mDNS to look for the snapserver to connect to on the local network.

    config SNAPSERVER_HOST
        string "Snapserver host"
        default "192.168.1.158"
        depends on !SNAPSERVER_USE_MDNS
        help
            Host (ip or name) of snapserver to connect to if mDNS is disabled or the mDNS resolution fails.

    config SNAPSERVER_PORT
        int "Snapserver port"
        default 1704
        depends on !SNAPSERVER_USE_MDNS
        help
            Port of the snapserver to connect to.

    config SNAPCLIENT_NAME
        string "snapclient name"
        default "ESP32-Caster"
        help
            Name of the client to register the snapserver.

	menu "HTTP Server Setting"

		config WEB_PORT
			int "User interface HTTP Server Port"
			default 8000
			help
				HTTP server port to use.

	endmenu

endmenu
```
